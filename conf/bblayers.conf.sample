## conf/bblayers.conf.sample
```bitbake
# POKY_BBLAYERS_CONF_VERSION is increased each time build/conf/bblayers.conf
# changes incompatibly
POKY_BBLAYERS_CONF_VERSION = "2"

BBPATH = "${TOPDIR}"
BBFILES ?= ""

BBLAYERS ?= " \
  /home/lucaslui/Desktop/Yocto/poky/meta \
  /home/lucaslui/Desktop/Yocto/poky/meta-poky \
  /home/lucaslui/Desktop/Yocto/poky/meta-yocto-bsp \
  /home/lucaslui/Desktop/Yocto/meta-openembedded/meta-oe \
  /home/lucaslui/Desktop/Yocto/meta-openembedded/meta-networking \
  /home/lucaslui/Desktop/Yocto/meta-openembedded/meta-filesystems \
  /home/lucaslui/Desktop/Yocto/meta-openembedded/meta-python \
  /home/lucaslui/Desktop/Yocto/meta-rust \
  /home/lucaslui/Desktop/Yocto/meta-virtualization \
  /home/lucaslui/Desktop/Yocto/meta-security/meta-tpm \
  /home/lucaslui/Desktop/Yocto/meta-clang \
  /home/lucaslui/Desktop/Yocto/meta-iotedge \
  /home/lucaslui/Desktop/Yocto/meta-smartsite \
  "
```

## conf/distro/smartsite.conf
```bitbake
DISTRO = "smartsite"
DISTRO_NAME = "Smartsite (Smartsite Embedded Linux Distro)"
DISTRO_VERSION = "0.1"
DISTRO_CODENAME = "dunfell"

MAINTAINER = "Lucas <lucas.motta@padtec.com.br>"

LOCALCONF_VERSION = "1"

DISTRO_FEATURES += "systemd virtualization"
VIRTUAL-RUNTIME_init_manager = "systemd"
VIRTUAL-RUNTIME_initscripts = "systemd-compat-units"
DISTRO_FEATURES_BACKFILL_CONSIDERED = "sysvinit"
```

## conf/layer.conf
```bitbake
# We have a conf and classes directory, add to BBPATH
BBPATH .= ":${LAYERDIR}"

# We have recipes-* directories, add to BBFILES
BBFILES += "${LAYERDIR}/recipes-*/*/*.bb \
            ${LAYERDIR}/recipes-*/*/*.bbappend"

BBFILE_COLLECTIONS += "meta-smartsite"
BBFILE_PATTERN_meta-smartsite = "^${LAYERDIR}/"
BBFILE_PRIORITY_meta-smartsite = "6"

LAYERDEPENDS_meta-smartsite = "core"
LAYERSERIES_COMPAT_meta-smartsite = "dunfell"
```
